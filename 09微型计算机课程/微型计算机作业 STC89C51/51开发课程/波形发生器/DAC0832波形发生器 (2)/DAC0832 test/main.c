/*头文件引用*/
#include <absacc.h>
#include <reg52.h>
#include <intrins.h>
/*宏定义*/
#define DAC0832 P2

#define num1 1
#define num2 2
#define num3 3
#define num4 4

sbit k1 = P3^0;
sbit k2 = P3^1;
sbit k3 = P3^2;
sbit k4 = P3^3;
/*变量声明*/
unsigned int key_num;
unsigned char wave_mode = 0;  // 变量名语义化

// 正弦波表
unsigned char code sin_table[] = {
    0x80,0x83,0x86,0x89,0x8D,0x90,0x93,0x96,0x99,0x9C,0x9F,0xA2,0xA5,0xA8,0xAB,0xAE,
    0xB1,0xB4,0xB7,0xBA,0xBC,0xBF,0xC2,0xC5,0xC7,0xCA,0xCC,0xCF,0xD1,0xD4,0xD6,0xD8,
    0xDA,0xDD,0xDF,0xE1,0xE3,0xE5,0xE7,0xE9,0xEA,0xEC,0xEE,0xEF,0xF1,0xF2,0xF4,0xF5,
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    0x51,0x55,0x57,0x5A,0x5D,0x60,0x63,0x66,0x69,0x6C,0x6F,0x72,0x76,0x79,0x7C,0x7F
};

// 10ms软件消抖延时函数（12MHz晶振）
void delay10ms()
{
    unsigned int i, j;
    for(i = 20; i > 0; i--)
        for(j = 248; j > 0; j--);
}

// 57μs精准波形延时函数（12MHz晶振）
void delay57us()
{
    unsigned char i = 28;
    while(i--);
}

// 独立按键扫描函数
unsigned int Key_Scan()
{
    static bit key_up = 1;  // 按键松开标志
    if((!k1 || !k2 || !k3 || !k4) && key_up)
    {
        key_up = 0;
        delay10ms();  // 软件消抖，替代定时器消抖
        
        if(k1 == 0) return num1;
        else if(k2 == 0) return num2;
        else if(k3 == 0) return num3;
        else if(k4 == 0) return num4;
    }
    else if(k1 && k2 && k3 && k4)
    {
        key_up = 1;
    }
    return 0;
}

// 锯齿波输出函数
void stair_wave()
{
    unsigned char i;
    for(i = 0; i < 255; i++)
    {
        DAC0832 = i;
        delay57us();
    }
}

// 方波输出函数
void square_wave()
{
    unsigned int i;
    DAC0832 = 0xFF;
    for(i = 0; i < 125; i++) delay57us();
    DAC0832 = 0x00;
    for(i = 0; i < 125; i++) delay57us();
}

// 三角波输出函数
void triangle_wave()
{
    unsigned char i;
    for(i = 0; i < 125; i++)
    {
        DAC0832 = i;
        delay57us();
    }
    for(i = 125; i > 0; i--)
    {
        DAC0832 = i;
        delay57us();
    }
}

// 正弦波输出函数
void sine_wave()
{
    unsigned char i;
    for(i = 0; i < 256; i++)
    {
        DAC0832 = sin_table[i];
        delay57us();
    }
}

// 按键处理与波形选择
void Key_Wave_Proc()
{
    key_num = Key_Scan();
    if(key_num != 0)
    {
        wave_mode = key_num;  // 仅在按键按下
    }
		
    switch(wave_mode)
    {
        case 1: square_wave();   break;
        case 2: triangle_wave(); break;
        case 3: stair_wave();    break;
        case 4: sine_wave();     break;
        default: break;
    }
}

void main()
{
    DAC0832 = 0x00;//初始输出低电平
    while(1)
    {
        Key_Wave_Proc();
    }
}