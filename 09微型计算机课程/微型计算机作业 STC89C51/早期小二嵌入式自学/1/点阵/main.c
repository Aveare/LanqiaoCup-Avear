#include"reg51.h"
sbit P1^0=key0;
unsigned char flag=0;

unsigned char code tab[]={
                        0x00,0x7E,0xFF,0xC3,0xC3,0xFF,0x7E,0x00, //0
                        0x00,0x00,0x43,0xFF,0xFF,0x03,0x00,0x00, //1
                        0x00,0x63,0xC7,0xCF,0xDB,0xF3,0x63,0x00, //2
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                        0x00,0x72,0xFB,0xDB,0xDB,0xFF,0x7E,0x00, //9         
                        };


unsigned char row[]={0x01,0x02,0x04,0x08,0x10,0x20,0x40,0x80};
unsigned char num=0;

void key()
{
	if(flag==0&&key0==0)
	{
		flag=1;
	}
	if(flag==1&&key0==1)
	{
	num++;
		flag=0
	}
	if(num==10)
	{
	num=0;
	}
}


void matrix()
{
	int i=0;
	for(i=8*num;i<8*(num+1);i++)
	{
		P2=~row[i-8*num];
		P3=tab[i];	
	}
	
}


void main()
{
	while(1)
	{
		matrix();
	}
}