/**********************************************************************
 * 文件名: ultrasound.c
 * 功能描述: 超声波测距模块，实现距离测量功能
 * 包含功能:
 *   - 超声波脉冲发送初始化
 *   - 超声波测距及距离计算
 **********************************************************************/

#include "ultrasound.h"
#include "intrins.h"

// 定义超声波模块引脚
sbit Tx = P1 ^ 0; // 发射引脚
sbit Rx = P1 ^ 1; // 接收引脚

/**
 * 功能: 12微秒延时函数
 * 描述: 用于超声波脉冲间隔控制
 */
void Delay12us(void)	//@12.000MHz
{
	unsigned char data i;

	_nop_();
	_nop_();
	i = 38;
	while (--i);
}



/**
 * 功能: 超声波脉冲发送初始化
 * 描述:
 *   - 发送8个40kHz的脉冲信号
 *   - 在发送期间关闭总中断以确保时序精确
 */
void Ut_Wave_Init()
{
	unsigned char i;
	EA = 0; // 关闭总中断
	for (i = 0; i < 8; i++)
	{
		Tx = 1;		 // 发送高电平
		Delay12us(); // 延时12us
		Tx = 0;		 // 发送低电平
		Delay12us(); // 延时12us
	}
	EA = 1; // 开启总中断
}

/**
 * 功能: 超声波测距函数
 * 描述:
 *   - 发送8个40kHz的脉冲，然后等待回波
 *   - 测量发送到接收的时间，计算距离
 *   - 计算公式: 距离S = 声速V × 时间T ÷ 2
 *     其中: V = 340m/s = 34000cm/s
 *           T = 计数时间(单位: us)
 *           S = 0.000001*34000/2 = 0.017cm/us
 * 返回值:
 *   测量的距离值(单位: cm)
 */
unsigned char Ut_Wave_Data()
{
	unsigned int time;
	CMOD = 0x00;	// 配置PCA计数器模式
	CH = CL = 0;	// 计数器清零
	Ut_Wave_Init(); // 发送脉冲信号
	CR = 1;			// 启动PCA计数器
	while ((Rx == 1) && (CF == 0))
		;	// 等待接收到回波或溢出
	CR = 0; // 停止PCA计数器

	// 如果没有溢出，则说明接收到了回波
	if (CF == 0)
	{
		time = CH << 8 | CL;   // 获取计数时间
		return (time * 0.017); // 转换为距离(cm)
	}
	else
	{
		CF = 0;	  // 清除溢出标志
		return 0; // 返回0表示超出测量范围
	}
}